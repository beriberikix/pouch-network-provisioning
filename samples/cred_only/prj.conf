## CMakeLists.txt
```
# Copyright (c) 2026 Jonathan Beri
# SPDX-License-Identifier: Apache-2.0
cmake_minimum_required(VERSION 3.20.0)
find_package(Zephyr REQUIRED HINTS $ENV{ZEPHYR_BASE})
project(cred_only)

target_sources(app PRIVATE src/main.c)

# mbedtls_user_config.h enables the x509 create/parse + base64 that pouch's
# saead build needs (see samples/basic for the rationale).
zephyr_include_directories(${CMAKE_CURRENT_SOURCE_DIR})
```

## Kconfig
```
source "Kconfig.zephyr"

config SAMPLE_POP
	string "Proof-of-possession secret"
	default "abcd1234"
```

## sample.yaml
```
sample:
  name: BLE-only credential bootstrap
  description: >
    Blank BLE-only device (no Wi-Fi) provisions a cloud device certificate
    over pouch, then reports itself provisioned. On a subsequent boot the
    stored certificate is reused and provisioning is skipped.
tests:
  sample.pouch_prov.cred_only:
    build_only: true
    platform_allow:
      - esp32s3_devkitc/esp32s3/procpu
      - nrf7002dk/nrf5340/cpuapp
    tags:
      - pouch_prov
```

## prj.conf
```kconfig
CONFIG_LOG=y
CONFIG_MAIN_STACK_SIZE=8192

# Pouch over BLE GATT, encrypted (saead) with device identity + PoP auth
CONFIG_POUCH=y
CONFIG_POUCH_ENCRYPTION_SAEAD=y
CONFIG_POUCH_VALIDATE_SERVER_CERT=n
CONFIG_POUCH_TRANSPORT_BLE_GATT=y
CONFIG_POUCH_BLOCK_SIZE=512
CONFIG_POUCH_THREAD_STACK_SIZE=4096
CONFIG_MBEDTLS_PSA_P256M_DRIVER_ENABLED=n
CONFIG_MBEDTLS_USER_CONFIG_FILE="mbedtls_user_config.h"

# Provisioning: credential bootstrap only (BLE-only device, no Wi-Fi)
CONFIG_POUCH_PROV=y
CONFIG_POUCH_PROV_WIFI=n
CONFIG_POUCH_PROV_CRED=y
CONFIG_POUCH_PROV_IDENTITY=y
CONFIG_POUCH_PROV_AUTH=y

# Bluetooth peripheral (LE Secure Connections)
CONFIG_BT=y
CONFIG_BT_PERIPHERAL=y
CONFIG_BT_SMP_ALLOW_UNAUTH_OVERWRITE=y
# Zephyr's default bond table holds a single peer, so a device provisioned from
# one phone silently rejects pairing from any other (SMP has nowhere to store
# the new bond, and the client only sees ATT "insufficient authentication").
CONFIG_BT_MAX_PAIRED=5
CONFIG_BT_L2CAP_TX_MTU=247
CONFIG_BT_BUF_ACL_RX_SIZE=251
CONFIG_BT_BUF_ACL_TX_SIZE=251

# Settings storage (BT bonds, device identity, cloud credentials)
CONFIG_SETTINGS=y
CONFIG_BT_SETTINGS=y
CONFIG_FLASH=y
CONFIG_FLASH_MAP=y
CONFIG_NVS=y
CONFIG_SETTINGS_NVS=y
```

## boards/nrf52840dk_nrf52840.conf
```kconfig
# Copyright (c) 2026 Jonathan Beri
# SPDX-License-Identifier: Apache-2.0
#
# nRF52840 DK overrides for the saead cred_only sample. The nRF runs Zephyr's
# software LL controller and does all P-256 ECDH on-device — both the LESC
# pairing DHKey and, for saead, the pouch session-key agreement. The software
# P-256 is stack-heavy, so several threads need more room than the sample's
# defaults; the crash otherwise is a stack overflow in the register-spill path.

# k_malloc() in the pouch/prov RPC allocator.
CONFIG_HEAP_MEM_POOL_SIZE=16384

# LESC key distribution / bond persistence runs on the system workqueue.
CONFIG_SYSTEM_WORKQUEUE_STACK_SIZE=4096

# The saead session-key ECDH runs on the Bluetooth host RX workqueue ("BT RX
# WQ", stack = BT_RX_STACK_SIZE); its 1200-byte default overflows during the
# software P-256 agreement (fault thread = bt_workq).
CONFIG_BT_RX_STACK_SIZE=6144

# Note: BT_CTLR_RX_PRIO_STACK_SIZE (the software controller's DHKey thread) is
# promptless upstream; validation uses an in-tree Zephyr patch raising its
# default to 4096. It cannot be set from this overlay.
```

## src/main.c
```c
/*
 * Copyright (c) 2026 Jonathan Beri
 * SPDX-License-Identifier: Apache-2.0
 *
 * BLE-only credential bootstrap: a blank device with no Wi-Fi radio advertises
 * for provisioning, the client bootstraps a cloud device certificate + key
 * over the encrypted pouch session, and the device stores them for its cloud
 * client. On a subsequent boot the stored credentials are reused and
 * provisioning is skipped.
 */

#include <zephyr/kernel.h>
#include <zephyr/logging/log.h>

#include <pouch_prov/manager.h>
#include <pouch_prov/credentials.h>

LOG_MODULE_REGISTER(main);

static void prov_event(enum pouch_prov_event event, const void *data, void *user_data)
{
	ARG_UNUSED(data);
	ARG_UNUSED(user_data);
	LOG_INF("Provisioning event %d", event);
}

static bool credentials_ready(void)
{
	return pouch_prov_cred_present(POUCH_PROV_CRED_DEVICE_CERT) &&
	       pouch_prov_cred_present(POUCH_PROV_CRED_PRIVATE_KEY);
}

int main(void)
{
	const struct pouch_prov_config config = {
		.pop = CONFIG_SAMPLE_POP,
		.device_id = "cred-only",
		.event_cb = prov_event,
	};
	int err;

	err = pouch_prov_mgr_init(&config);
	if (err != 0) {
		LOG_ERR("init failed (%d)", err);
		return err;
	}

	if (!credentials_ready()) {
		LOG_INF("Blank device — starting provisioning");
		err = pouch_prov_mgr_start();
		if (err != 0) {
			LOG_ERR("start failed (%d)", err);
			return err;
		}
		/* Wait until the client finishes (ctrl end or autostop). */
		(void)pouch_prov_mgr_wait(K_FOREVER);
		LOG_INF("Provisioning complete");
	}

	if (pouch_prov_mgr_is_provisioned()) {
		size_t cert_len = 0;

		(void)pouch_prov_cred_get(POUCH_PROV_CRED_DEVICE_CERT, &cert_len);
		LOG_INF("Provisioned: cloud device certificate stored (%zu bytes)", cert_len);
		/* An application would hand these credentials to its cloud client. */
	} else {
		LOG_WRN("No credentials available");
	}

	return 0;
}
```
