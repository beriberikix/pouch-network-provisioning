## CMakeLists.txt
```
# Copyright (c) 2026 Jonathan Beri
# SPDX-License-Identifier: Apache-2.0
cmake_minimum_required(VERSION 3.20.0)
find_package(Zephyr REQUIRED HINTS $ENV{ZEPHYR_BASE})
project(pouch_prov_basic)

target_sources(app PRIVATE src/main.c)

# Expose mbedtls_user_config.h (CONFIG_MBEDTLS_USER_CONFIG_FILE) on the
# include path for the saead build overlay.
zephyr_include_directories(${CMAKE_CURRENT_SOURCE_DIR})
```

## Kconfig
```
source "Kconfig.zephyr"

config SAMPLE_POP
	string "Proof-of-possession secret (empty disables auth)"
	default ""
```

## prj.conf
```kconfig
CONFIG_LOG=y
CONFIG_MAIN_STACK_SIZE=4096

# Pouch over BLE GATT, plaintext for M2 transport bring-up (saead in M3)
CONFIG_POUCH=y
CONFIG_POUCH_ENCRYPTION_NONE=y
CONFIG_POUCH_TRANSPORT_BLE_GATT=y
CONFIG_POUCH_BLOCK_SIZE=512
CONFIG_POUCH_THREAD_STACK_SIZE=4096

CONFIG_POUCH_PROV=y
CONFIG_POUCH_PROV_WIFI=n
CONFIG_POUCH_PROV_CRED=n
CONFIG_POUCH_PROV_IDENTITY=n

# Bluetooth peripheral
CONFIG_BT=y
CONFIG_BT_PERIPHERAL=y
CONFIG_BT_DEVICE_NAME="pouch-prov"
CONFIG_BT_L2CAP_TX_MTU=247
CONFIG_BT_BUF_ACL_RX_SIZE=251
CONFIG_BT_BUF_ACL_TX_SIZE=251

# LE Secure Connections pairing (Just Works). On esp32s3, disabling the p256m
# PSA driver left LESC's P-256 ECDH on an mbedTLS/PSA path that is not properly
# initialised, so pairing crashed the device (load-prohibited fault right after
# the public-key exchange). p256m is a self-contained constant-time secp256r1
# implementation with no platform-crypto-init dependency, so keep it enabled.
# (The upstream "p256m breaks secp384r1" note only affects cert/saead builds,
# which this transport bring-up sample does not use.)
CONFIG_MBEDTLS_PSA_P256M_DRIVER_ENABLED=y
# The host P-256 keygen/DHKey run on bt_long_wq, and the LESC confirm/DHKey-check
# crypto runs on the BT RX thread. The default stacks (1400 / 1200 bytes) are too
# small for the mbedTLS-PSA P-256 work, which overflowed during pairing (Xtensa
# stack-overflow fault in the register-spill restore). Size both generously.
CONFIG_BT_LONG_WQ_STACK_SIZE=4096
CONFIG_BT_RX_STACK_SIZE=4096
CONFIG_BT_SMP_ALLOW_UNAUTH_OVERWRITE=y
# Zephyr's default bond table holds a single peer, so a device provisioned from
# one phone silently rejects pairing from any other (SMP has nowhere to store
# the new bond, and the client only sees ATT "insufficient authentication").
CONFIG_BT_MAX_PAIRED=5

# KNOWN ISSUE (not fixed here): on esp32s3 with Zephyr v4.3.0, a *bonded*
# LE reconnect is terminated by the controller with a MIC failure (HCI 0x3d)
# right after encryption is enabled, so only the first (pairing) connection
# works. This is upstream Zephyr #108785, fixed on main/v4.4 by #109304
# (coordinated hal_espressif controller-lib + BT-driver Kconfig changes that
# do not backport cleanly to v4.3.0). The real fix is moving the Zephyr pin to
# v4.4.1+ in step with pouch. See west.yml.

# Persist bonds across reboots so a reflash doesn't strand a central's
# cached key. settings_load() in the manager restores the identity + bonds.
CONFIG_BT_SETTINGS=y
CONFIG_SETTINGS=y
CONFIG_FLASH=y
CONFIG_FLASH_MAP=y
CONFIG_NVS=y
CONFIG_SETTINGS_NVS=y

# Debug (M2 bring-up)
CONFIG_POUCH_TRANSPORT_LOG_LEVEL_DBG=y
CONFIG_POUCH_PROV_LOG_LEVEL_DBG=y
CONFIG_LOG_MODE_IMMEDIATE=y
CONFIG_BT_SMP_LOG_LEVEL_DBG=y
CONFIG_BT_CONN_LOG_LEVEL_DBG=y
```

## saead.conf
```kconfig
# Overlay: build the basic sample in encrypted (saead) mode with the M3
# device identity + PoP auth. Used for M3 compile/bring-up:
#   west build -b <board> samples/basic -- -DEXTRA_CONF_FILE=saead.conf
CONFIG_POUCH_ENCRYPTION_NONE=n
CONFIG_POUCH_ENCRYPTION_SAEAD=y
CONFIG_POUCH_VALIDATE_SERVER_CERT=n

CONFIG_POUCH_PROV_IDENTITY=y
CONFIG_POUCH_PROV_AUTH=y

CONFIG_SAMPLE_POP="abcd1234"

# saead's P-256 ECDH pairing needs the same p256m workaround as BT SC.
CONFIG_MBEDTLS_PSA_P256M_DRIVER_ENABLED=n
CONFIG_MBEDTLS_USER_CONFIG_FILE="mbedtls_user_config.h"
```

## wifi.conf
```kconfig
# Overlay: enable Wi-Fi provisioning endpoints (compile/bring-up).
#   west build -b esp32s3_devkitc/esp32s3/procpu samples/basic \
#     -- -DEXTRA_CONF_FILE="saead.conf;wifi.conf"
CONFIG_POUCH_PROV_WIFI=y
CONFIG_WIFI=y
CONFIG_WIFI_CREDENTIALS=y
CONFIG_NETWORKING=y
CONFIG_NET_L2_WIFI_MGMT=y
CONFIG_NET_IPV4=y
CONFIG_NET_DHCPV4=y
CONFIG_WIFI_CREDENTIALS_BACKEND_SETTINGS=y
```

## boards/nrf52840dk_nrf52840.conf
```kconfig
# Copyright (c) 2026 Jonathan Beri
# SPDX-License-Identifier: Apache-2.0
#
# nRF52840 DK overrides for samples/basic. Validated end-to-end against a phone:
# scan -> connect -> LESC bond -> reconnect -> pouch .prov/ver + .prov/ctrl.
#
# Unlike esp32s3 (blob controller), nRF runs Zephyr's software LL controller and
# does the LESC P-256 work on-device, which needs more stack on several threads
# than the sample's defaults provide (the crash otherwise is a stack overflow in
# the register-spill path). It also uses a kernel heap for the RPC allocator.

# k_malloc() in src/rpc.c (esp32 pulls a heap pool in via its SoC defaults).
CONFIG_HEAP_MEM_POOL_SIZE=16384

# LESC key distribution / bond persistence runs on the system workqueue.
CONFIG_SYSTEM_WORKQUEUE_STACK_SIZE=4096

# KNOWN GAP: the software controller computes the P-256 DHKey on its RX-priority
# thread, whose upstream default (CONFIG_BT_CTLR_RX_PRIO_STACK_SIZE=448) overflows
# during pairing. That symbol is *promptless* with an unconditional upstream
# default, so it cannot be raised from a downstream .conf or `configdefault`.
# End-to-end validation used a local Zephyr patch bumping it to 4096. The clean
# fix is upstream (make it configurable / raise it) — tracked with the ESP32-S3
# reconnect work in the v4.4.1 Zephyr bump.
```

## src/main.c
```c
/*
 * Copyright (c) 2026 Jonathan Beri
 * SPDX-License-Identifier: Apache-2.0
 *
 * Minimal provisioning target: starts the provisioning service and
 * waits. Used for transport bring-up with the pouchprov CLI.
 */

#include <zephyr/kernel.h>
#include <zephyr/logging/log.h>

#include <pouch_prov/manager.h>

LOG_MODULE_REGISTER(main);

static void prov_event(enum pouch_prov_event event, const void *data, void *user_data)
{
	LOG_INF("Provisioning event: %d", event);
}

int main(void)
{
	const struct pouch_prov_config config = {
		.pop = CONFIG_SAMPLE_POP[0] != '\0' ? CONFIG_SAMPLE_POP : NULL,
		.device_id = "pouch-prov-basic",
		.event_cb = prov_event,
	};
	int err;

	err = pouch_prov_mgr_init(&config);
	if (err != 0) {
		LOG_ERR("init failed (%d)", err);
		return err;
	}

	err = pouch_prov_mgr_start();
	if (err != 0) {
		LOG_ERR("start failed (%d)", err);
		return err;
	}

	LOG_INF("Provisioning service running");
	(void)pouch_prov_mgr_wait(K_FOREVER);
	LOG_INF("Provisioning ended");

	return 0;
}
```
