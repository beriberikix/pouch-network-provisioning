## Kconfig
```kconfig
# Copyright (c) 2026 Jonathan Beri
# SPDX-License-Identifier: Apache-2.0

menuconfig POUCH_PROV
	bool "Pouch network provisioning"
	depends on POUCH
	depends on POUCH_TRANSPORT_BLE_GATT
	depends on BT_PERIPHERAL
	select EVENTS
	# pouch's GATT characteristics require an encrypted (LESC) link for
	# writes; without SMP the client can never pair and writes are dropped.
	select BT_SMP
	help
	  Local network provisioning over the pouch protocol. Provisioning
	  messages are pouch entries on reserved ".prov/*" paths, carried over
	  pouch's BLE GATT transport. The session is terminated locally by a
	  provisioning client (CLI or mobile app) acting in the pouch server
	  role. Production builds must select POUCH_ENCRYPTION_SAEAD (a choice
	  symbol, so it cannot be selected from here).

if POUCH_PROV

config POUCH_PROV_WIFI
	bool "Wi-Fi provisioning endpoints"
	default y
	select EXPERIMENTAL
	depends on WIFI
	select WIFI_CREDENTIALS
	select NET_MGMT
	select NET_MGMT_EVENT
	help
	  Enable the .prov/config, .prov/scan and .prov/ctrl endpoints for
	  Wi-Fi station provisioning.

config POUCH_PROV_CRED
	bool "Cloud credential bootstrap endpoint (.prov/cred)"
	default y
	depends on SETTINGS
	help
	  Accept a device certificate, private key and optional CA certificate
	  over the encrypted provisioning session and persist them via the
	  settings subsystem for use by the application (e.g. with the Golioth
	  Firmware SDK for certificate-based zero-touch enrollment).

config POUCH_PROV_IDENTITY
	bool "Generate ephemeral device identity on first boot"
	default y if POUCH_ENCRYPTION_SAEAD
	depends on SETTINGS
	select MBEDTLS
	select MBEDTLS_X509_CRT_WRITE_C
	select MBEDTLS_PK_WRITE_C
	select PSA_WANT_KEY_TYPE_ECC_KEY_PAIR_GENERATE
	select PSA_WANT_KEY_TYPE_ECC_KEY_PAIR_DERIVE
	select PSA_WANT_ALG_ECDH
	select PSA_WANT_ALG_ECDSA
	select PSA_WANT_ECC_SECP_R1_256
	select PSA_WANT_ALG_SHA_256
	help
	  On first boot, generate a P-256 key pair and a self-signed X.509
	  certificate to serve as the device's pouch identity, and persist
	  them via the settings subsystem. Required for blank devices that
	  have no factory-provisioned pouch credentials.

config POUCH_PROV_AUTH
	bool "Proof-of-possession session authorization (.prov/auth)"
	default y
	select PSA_WANT_ALG_HMAC
	select PSA_WANT_KEY_TYPE_HMAC
	select PSA_WANT_ALG_SHA_256
	help
	  Require a mutual HMAC-SHA256 proof-of-possession challenge-response
	  inside the encrypted pouch session before accepting provisioning
	  commands. The PoP secret is supplied by the application at init.

config POUCH_PROV_RESPONSE_WAIT_MS
	int "Response wait budget for an uplink pouch (ms)"
	default 12000
	help
	  How long the uplink handler waits for pending responses before
	  closing an uplink pouch empty (the client treats an empty pouch
	  as "retry later").

config POUCH_PROV_SCAN_CACHE
	int "Maximum cached Wi-Fi scan results"
	default 16

config POUCH_PROV_AUTOSTOP_TIMEOUT_S
	int "Auto-stop timeout after provisioning completes (seconds)"
	default 0
	help
	  Automatically stop the manager this many seconds after the terminal
	  provisioning step (a Wi-Fi device once its station connects, or a
	  BLE-only device once cloud credentials are stored), so a client that
	  never sends an explicit .prov/ctrl end still lets the device proceed
	  to normal operation. 0 disables auto-stop; the application (or a
	  .prov/ctrl end from the client) stops the manager instead.

config POUCH_PROV_DEVICE_NAME_PREFIX
	string "BLE device name prefix"
	default "PVN-"
	help
	  Advertised name is this prefix plus the last three bytes of the
	  Bluetooth device address in hex.

module = POUCH_PROV
module-str = pouch_prov
source "subsys/logging/Kconfig.template.log_config"

endif # POUCH_PROV

rsource "sim/wifi/Kconfig"
```

## sim/wifi/Kconfig
```kconfig
# Copyright (c) 2026 Jonathan Beri
# SPDX-License-Identifier: Apache-2.0

config POUCH_PROV_FAKE_WIFI
	bool "Fake (simulated) Wi-Fi driver for tests"
	depends on NETWORKING
	select WIFI
	select WIFI_USE_NATIVE_NETWORKING
	select NET_L2_ETHERNET
	select NET_L2_WIFI_MGMT
	help
	  A hardware-less Wi-Fi offload network interface for native_sim. It
	  answers scan/connect/iface_status with programmable, deterministic
	  results so the provisioning handlers can be exercised in simulation,
	  including failure injection. Test-only.

if POUCH_PROV_FAKE_WIFI

config POUCH_PROV_FAKE_WIFI_MAX_AP
	int "Maximum number of canned scan APs"
	default 8

endif
```

## tests/bsim/ble_smoke/testcase.yaml
```yaml
# Copyright (c) 2026 Jonathan Beri
# SPDX-License-Identifier: Apache-2.0
tests:
  pouch_prov.bsim.ble_smoke:
    tags:
      - pouch_prov
      - bluetooth
    harness: pytest
    harness_config:
      pytest_dut_scope: module
    sysbuild: true
    platform_allow:
      - nrf52_bsim
    integration_platforms:
      - nrf52_bsim
    timeout: 120
```

## tests/codec/testcase.yaml
```yaml
tests:
  pouch_prov.codec:
    platform_allow:
      - native_sim
    tags:
      - pouch_prov
```

## tests/cred_store/testcase.yaml
```yaml
tests:
  pouch_prov.cred_store:
    platform_allow:
      - native_sim
    tags:
      - pouch_prov
      - cred
```

## tests/wifi_handlers/testcase.yaml
```yaml
tests:
  pouch_prov.wifi_handlers:
    platform_allow:
      - native_sim
    tags:
      - pouch_prov
      - wifi
```

## west.yml
```yaml
# Copyright (c) 2026 Jonathan Beri
# SPDX-License-Identifier: Apache-2.0
#
# West manifest for developing pouch-network-provisioning standalone.
# Downstream users add this repo as a project in their own manifest instead.
manifest:
  # Zephyr's manifest disables the babblesim group by default; enable it so
  # the bsim BLE tests (tests/bsim) can build the simulator from tools/bsim.
  group-filter: [+babblesim]

  self:
    path: pouch-network-provisioning

  remotes:
    - name: zephyrproject
      url-base: https://github.com/zephyrproject-rtos
    - name: golioth
      url-base: https://github.com/golioth

  projects:
    # Same Zephyr revision pouch pins (pouch west-zephyr.yml).
    #
    # NOTE (BLE bonded-reconnect MIC failure on ESP32-S3): v4.3.0's bundled
    # ESP32-S3 BT controller terminates every bonded LE reconnect with a MIC
    # failure (HCI 0x3d). This is upstream Zephyr issue #108785, fixed on main
    # / v4.4 by #109304 (coordinated hal_espressif controller-lib + BT-driver
    # Kconfig changes). The fix does not cleanly backport onto v4.3.0. Moving
    # this pin to v4.4.1+ (in step with pouch) is the real fix.
    - name: zephyr
      remote: zephyrproject
      revision: v4.3.0
      import:
        name-allowlist:
          - cmsis_6
          - hal_espressif
          - hal_nordic
          - hal_nxp
          - littlefs
          - mbedtls
          - mcuboot
          - net-tools
          - nrf_hw_models # nRF radio HW models for the nrf52_bsim board
          - segger
          - tinycrypt
          - zcbor
        # BabbleSim simulator + components (babblesim group), for tests/bsim.
        path-allowlist:
          - tools/bsim
          - tools/bsim/*
          - tools/bsim/*/*
    - name: pouch
      remote: golioth
      revision: 18ae45883ce23eb1e0de0dc87ee81dbb9c983043
      path: modules/lib/pouch
    # Only needed by samples/golioth_bootstrap.
    - name: golioth-firmware-sdk
      remote: golioth
      revision: 1996a1d3b73fe5df39b5780f53f6ed091c1a82db
      path: modules/lib/golioth-firmware-sdk
      submodules: true
      groups:
        - samples
```
