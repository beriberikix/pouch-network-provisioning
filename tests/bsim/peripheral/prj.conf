## CMakeLists.txt
```
# Copyright (c) 2026 Jonathan Beri
# SPDX-License-Identifier: Apache-2.0
cmake_minimum_required(VERSION 3.20.0)
find_package(Zephyr REQUIRED HINTS $ENV{ZEPHYR_BASE})
project(pouch_prov_bsim_peripheral)

target_sources(app PRIVATE src/main.c)
```

## prj.conf
```kconfig
# Copyright (c) 2026 Jonathan Beri
# SPDX-License-Identifier: Apache-2.0
#
# BabbleSim DUT image: the provisioning service in plaintext mode
# (samples/basic minus persistence — no flash on the simulated nRF52
# is needed; manager.c guards all settings usage behind IS_ENABLED).
CONFIG_LOG=y
CONFIG_LOG_MODE_IMMEDIATE=y
CONFIG_MAIN_STACK_SIZE=4096
# src/rpc.c k_malloc()s response buffers (<= POUCH_PROV_MSG_MAX each).
CONFIG_HEAP_MEM_POOL_SIZE=8192

CONFIG_POUCH=y
CONFIG_POUCH_ENCRYPTION_NONE=y
CONFIG_POUCH_TRANSPORT_BLE_GATT=y
CONFIG_POUCH_BLOCK_SIZE=512
CONFIG_POUCH_THREAD_STACK_SIZE=4096

CONFIG_POUCH_PROV=y
CONFIG_POUCH_PROV_WIFI=n
CONFIG_POUCH_PROV_CRED=n
CONFIG_POUCH_PROV_IDENTITY=n
CONFIG_POUCH_PROV_AUTH=n

CONFIG_BT=y
CONFIG_BT_PERIPHERAL=y
CONFIG_BT_DEVICE_NAME="pouch-prov-bsim"
CONFIG_BT_SMP_ALLOW_UNAUTH_OVERWRITE=y
CONFIG_BT_L2CAP_TX_MTU=247
CONFIG_BT_BUF_ACL_RX_SIZE=251
CONFIG_BT_BUF_ACL_TX_SIZE=251
CONFIG_BT_CTLR_DATA_LENGTH_MAX=251

# The p256m driver is pulled in by BT_SMP but breaks the P-256 ECDH used
# for LE Secure Connections pairing (matches samples/basic).
CONFIG_MBEDTLS_PSA_P256M_DRIVER_ENABLED=n

CONFIG_POUCH_TRANSPORT_LOG_LEVEL_DBG=y
CONFIG_POUCH_PROV_LOG_LEVEL_DBG=y
```

## src/main.c
```c
/*
 * Copyright (c) 2026 Jonathan Beri
 * SPDX-License-Identifier: Apache-2.0
 *
 * BabbleSim DUT: starts the provisioning service (plaintext pouch) and
 * waits, mirroring samples/basic. The central tester image drives it
 * over the simulated 2.4GHz phy.
 */

#include <zephyr/kernel.h>
#include <zephyr/logging/log.h>

#include <pouch_prov/manager.h>

LOG_MODULE_REGISTER(main);

static void prov_event(enum pouch_prov_event event, const void *data, void *user_data)
{
	LOG_INF("Provisioning event: %d", event);
}

int main(void)
{
	const struct pouch_prov_config config = {
		.device_id = "bsim-dut",
		.event_cb = prov_event,
	};
	int err;

	err = pouch_prov_mgr_init(&config);
	if (err != 0) {
		LOG_ERR("init failed (%d)", err);
		return err;
	}

	err = pouch_prov_mgr_start();
	if (err != 0) {
		LOG_ERR("start failed (%d)", err);
		return err;
	}

	LOG_INF("Provisioning service running");
	(void)pouch_prov_mgr_wait(K_FOREVER);
	LOG_INF("Provisioning ended");

	return 0;
}
```
