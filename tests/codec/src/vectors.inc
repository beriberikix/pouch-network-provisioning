/* Generated by scripts/vectors_to_c.py — do not edit. */
static const uint8_t vec_ver_req[] = {0x81, 0x00};
static const uint8_t vec_auth_challenge[] = {0x82, 0x00, 0x50, 0x00, 0x01, 0x02, 0x03, 0x04, 0x05, 0x06, 0x07, 0x08, 0x09, 0x0a, 0x0b, 0x0c, 0x0d, 0x0e, 0x0f};
static const uint8_t vec_auth_proof[] = {0x82, 0x01, 0x58, 0x20, 0x00, 0x01, 0x02, 0x03, 0x04, 0x05, 0x06, 0x07, 0x08,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 0x1e, 0x1f};
static const uint8_t vec_config_get_status[] = {0x81, 0x00};
static const uint8_t vec_config_set_full[] = {0x82, 0x01, 0xa4, 0x64, 0x73, 0x73, 0x69, 0x64, 0x46, 0x6d, 0x79, 0x73, 0x73,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 0x68, 0x0b};
static const uint8_t vec_config_set_minimal[] = {0x82, 0x01, 0xa1, 0x64, 0x73, 0x73, 0x69, 0x64, 0x48, 0x6f, 0x70, 0x65, 0x6e, 0x2d, 0x6e, 0x65, 0x74};
static const uint8_t vec_config_apply[] = {0x81, 0x02};
static const uint8_t vec_scan_start_defaults[] = {0x82, 0x00, 0xa0};
static const uint8_t vec_scan_start_passive[] = {0x82, 0x00, 0xa2, 0x67, 0x70, 0x61, 0x73, 0x73, 0x69, 0x76, 0x65, 0xf5, 0x69, 0x70, 0x65, 0x72, 0x69, 0x6f, 0x64, 0x2d, 0x6d, 0x73, 0x18, 0x78};
static const uint8_t vec_scan_get_status[] = {0x81, 0x01};
static const uint8_t vec_scan_get_results[] = {0x83, 0x02, 0x04, 0x06};
static const uint8_t vec_cred_write[] = {0x82, 0x00, 0xa4, 0x64, 0x6b, 0x69, 0x6e, 0x64, 0x00, 0x63, 0x6f, 0x66, 0x66, 0x00, 0x65, 0x74, 0x6f, 0x74, 0x61, 0x6c, 0x06, 0x64, 0x64, 0x61, 0x74, 0x61, 0x46, 0x30, 0x82, 0x01, 0x02, 0xaa, 0xbb};
static const uint8_t vec_cred_finalize[] = {0x81, 0x01};
static const uint8_t vec_cred_get_status[] = {0x81, 0x02};
static const uint8_t vec_ctrl_reset[] = {0x81, 0x00};
static const uint8_t vec_ctrl_reprov[] = {0x81, 0x01};
static const uint8_t vec_ctrl_end[] = {0x81, 0x02};
static const uint8_t vec_ver_rsp[] = {0x83, 0x00, 0x00, 0xa5, 0x65, 0x70, 0x72, 0x6f, 0x74, 0x6f, 0x01, 0x64, 0x63,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 0x70, 0xf5};
static const uint8_t vec_auth_challenge_rsp[] = {0x84, 0x00, 0x00, 0x50, 0x10, 0x11, 0x12, 0x13, 0x14, 0x15, 0x16, 0x17, 0x18,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 0x3e, 0x3f};
static const uint8_t vec_auth_proof_rsp[] = {0x82, 0x01, 0x00};
static const uint8_t vec_auth_proof_rsp_unauthorized[] = {0x82, 0x01, 0x04};
static const uint8_t vec_config_status_connecting[] = {0x83, 0x00, 0x00, 0x01};
static const uint8_t vec_config_status_failed_auth[] = {0x84, 0x00, 0x00, 0x03, 0x00};
static const uint8_t vec_config_status_connected[] = {0x84, 0x00, 0x00, 0x00, 0xa3, 0x63, 0x69, 0x70, 0x34, 0x44, 0xc0, 0xa8, 0x01, 0x07, 0x64, 0x73, 0x73, 0x69, 0x64, 0x46, 0x6d, 0x79, 0x73, 0x73, 0x69, 0x64, 0x64, 0x72, 0x73, 0x73, 0x69, 0x38, 0x28};
static const uint8_t vec_config_set_rsp[] = {0x82, 0x01, 0x00};
static const uint8_t vec_config_apply_rsp[] = {0x82, 0x02, 0x00};
static const uint8_t vec_scan_start_rsp[] = {0x82, 0x00, 0x00};
static const uint8_t vec_scan_status_rsp[] = {0x84, 0x01, 0x00, 0xf5, 0x09};
static const uint8_t vec_scan_results_rsp[] = {0x83, 0x02, 0x00, 0x82, 0xa5, 0x64, 0x73, 0x73, 0x69, 0x64, 0x46, 0x6d, 0x79,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 0x68, 0x00};
static const uint8_t vec_cred_write_rsp[] = {0x83, 0x00, 0x00, 0x06};
static const uint8_t vec_cred_finalize_rsp[] = {0x82, 0x01, 0x00};
static const uint8_t vec_cred_status_rsp[] = {0x83, 0x02, 0x00, 0xa2, 0x61, 0x30, 0x19, 0x04, 0x12, 0x61, 0x31, 0x18, 0x79};
static const uint8_t vec_ctrl_end_rsp[] = {0x82, 0x02, 0x00};
static const uint8_t frame_single_entry[] = {0x82, 0x01, 0x82, 0x00, 0x65, 0x64, 0x65, 0x76, 0x2d, 0x31, 0x00, 0x11, 0xc0, 0x00, 0x02, 0x00, 0x3c, 0x09, 0x2e, 0x70, 0x72, 0x6f, 0x76, 0x2f, 0x76, 0x65, 0x72, 0x81, 0x00};
static const uint8_t frame_two_entries_one_block[] = {0x82, 0x01, 0x82, 0x00, 0x65, 0x64, 0x65, 0x76, 0x2d, 0x31, 0x00, 0x42, 0xc0,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 0x81, 0x02};
static const uint8_t frame_two_blocks[] = {0x82, 0x01, 0x82, 0x00, 0x65, 0x64, 0x65, 0x76, 0x2d, 0x31, 0x00, 0x45, 0x40,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 0x00, 0x00};
static const uint8_t frame_empty[] = {0x82, 0x01, 0x82, 0x00, 0x65, 0x64, 0x65, 0x76, 0x2d, 0x31, 0x00, 0x01, 0xc0};
